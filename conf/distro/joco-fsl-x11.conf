## conf/distro/joco-fsl-x11.conf
```bitbake
# Joco Quad/Solo SABRESD FSL Distro for X11 without wayland.

require conf/distro/include/fsl-base.inc

DISTRO = "joco-fsl-x11"
DISTRO_NAME = "Joco Quad/Solo SABRESD FSL X11"
MAINTAINER = "Joseph Chen <jocodoma@gmail.com>"

# Remove conflicting backends and add x11
DISTRO_FEATURES_remove = "wayland"
DISTRO_FEATURES_append = " x11"

# init
# DISTRO_FEATURES_append = " systemd"
# DISTRO_FEATURES_BACKFILL_CONSIDERED = "sysvinit"
# VIRTUAL-RUNTIME_init_manager = "systemd"
# VIRTUAL-RUNTIME_initscripts = ""

# u-boot
# PREFERRED_VERSION_u-boot-imx = "2016.03_xxx"
# unset UBOOT_MACHINE
# UBOOT_CONFIG ??= "quad solo"
# UBOOT_CONFIG[quad] = "mx6qsabresd_defconfig"
# UBOOT_CONFIG[solo] = "mx6solosabresd_defconfig"

# kernel
# PREFERRED_PROVIDER_virtual/kernel_mx6dl = "linux-fslc-imx"
# PREFERRED_PROVIDER_virtual/kernel_mx6q = "linux-fslc-imx"
# PREFERRED_VERSION_linux-fslc-imx = "4.9.67_xxx"
# KERNEL_DEVICETREE = " \
#     imx6dl-sabresd.dtb \
#     imx6q-sabresd.dtb \
# "

# Depending on the setup in u-boot
# SERIAL_CONSOLES = "115200;ttymxc4"

# ToDo: time zone settings for various images

# Remove unnecessary features
# For more info:
# https://www.yoctoproject.org/docs/latest/ref-manual/ref-manual.html#ref-features-machine
# https://www.yoctoproject.org/docs/latest/ref-manual/ref-manual.html#ref-features-distro
MACHINE_FEATURES_remove = "alsa bluetooth wifi"
DISTRO_FEATURES_remove = "alsa bluetooth bluez5 ipv6 pcmcia wifi nfs 3g nfc pulseaudio"
```

## conf/distro/joco-imx-x11.conf
```bitbake
# Joco Quad/Solo SABRESD i.MX Distro for X11 with no wayland.

include conf/distro/include/fsl-imx-base.inc
include conf/distro/include/fsl-imx-preferred-env.inc

DISTRO = "joco-imx-x11"
DISTRO_NAME = "Joco Quad/Solo SABRESD iMX X11"
MAINTAINER = "Joseph Chen <jocodoma@gmail.com>"

# Remove conflicting backends and add x11
DISTRO_FEATURES_remove = "wayland"
DISTRO_FEATURES_append = " x11"

# init
# DISTRO_FEATURES_append = " systemd"
# DISTRO_FEATURES_BACKFILL_CONSIDERED = "sysvinit"
# VIRTUAL-RUNTIME_init_manager = "systemd"
# VIRTUAL-RUNTIME_initscripts = ""

# u-boot
# PREFERRED_VERSION_u-boot-imx = ""
# unset UBOOT_MACHINE
# UBOOT_CONFIG ??= "quad solo"
# UBOOT_CONFIG[quad] = "mx6qsabresd_defconfig"
# UBOOT_CONFIG[solo] = "mx6solosabresd_defconfig"
# UBOOT_SUFFIX = "imx"
# SPL_BINARY = ""

# kernel
# PREFERRED_PROVIDER_virtual/kernel_mx6dl = "linux-fslc-imx"
# PREFERRED_PROVIDER_virtual/kernel_mx6q = "linux-fslc-imx"
# PREFERRED_VERSION_linux-fslc-imx = ""
# KERNEL_DEVICETREE = " \
#     imx6dl-sabresd.dtb \
#     imx6q-sabresd.dtb \
# "

# Remove unnecessary features
RDEPENDS_packagegroup-core-tools-testapps_remove = "mesa-demos"
RDEPENDS_packagegroup-fsl-tools-gpu-external_remove = "mesa-demos"

# ToDo
#MACHINE_FEATURES_remove = "wifi bluetooth"
#DISTRO_FEATURES_remove = "alsa bluetooth bluez5 wifi pulseaudio"
```

## conf/layer.conf
```bitbake
# We have a conf and classes directory, add to BBPATH
BBPATH .= ":${LAYERDIR}"

# We have recipes-* directories, add to BBFILES
BBFILES += "${LAYERDIR}/recipes-*/*/*.bb \
            ${LAYERDIR}/recipes-*/*/*.bbappend"

BBFILE_COLLECTIONS += "meta-joco-imx"
BBFILE_PATTERN_meta-joco-imx = "^${LAYERDIR}/"
BBFILE_PRIORITY_meta-joco-imx = "6"

LAYERDEPENDS_meta-joco-imx = "core"
LAYERSERIES_COMPAT_meta-joco-imx = "warrior zeus"
```
